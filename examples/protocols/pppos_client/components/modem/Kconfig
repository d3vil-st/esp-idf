## examples/protocols/pppos_client/components/modem/Kconfig
```kconfig
menu "Modem Configuration"

    config MODEM_APN
        string "Set Access Point Name (APN)"
        default ""
        help
            Logical name which is used to select the GGSN or the external packet data network.

    config MODEM_PPP_AUTH_USERNAME
        string "Set username for authentication"
        default ""
        help
            Set username for PPP Authentication.

    config MODEM_PPP_AUTH_PASSWORD
        string "Set password for authentication"
        default ""
        help
            Set password for PPP Authentication.

    menu "UART Configuration"
        config UART_MODEM_TX_PIN
            int "TXD Pin Number"
            default 22
            range 0 31
            help
                Pin number of UART TX.

        config UART_MODEM_RX_PIN
            int "RXD Pin Number"
            default 23
            range 0 31
            help
                Pin number of UART RX.

        config UART_MODEM_RTS_PIN
            int "RTS Pin Number"
            default 0
            range 0 31
            help
                Pin number of UART RTS.

        config UART_MODEM_CTS_PIN
            int "CTS Pin Number"
            default 0
            range 0 31
            help
                Pin number of UART CTS.

        config UART_EVENT_TASK_STACK_SIZE
            int "UART Event Task Stack Size"
            range 2000 6000
            default 2048
            help
                Stack size of UART event task.

        config UART_EVENT_TASK_PRIORITY
            int "UART Event Task Priority"
            range 3 22
            default 5
            help
                Priority of UART event task.

        config UART_EVENT_QUEUE_SIZE
            int "UART Event Queue Size"
            range 10 40
            default 30
            help
                Length of UART event queue.

        config UART_PATTERN_QUEUE_SIZE
            int "UART Pattern Queue Size"
            range 10 40
            default 20
            help
                Length of UART pattern queue.

        config UART_TX_BUFFER_SIZE
            int "UART TX Buffer Size"
            range 256 2048
            default 512
            help
                Buffer size of UART TX buffer.

        config UART_RX_BUFFER_SIZE
            int "UART RX Buffer Size"
            range 256 4096
            default 1024
            help
                Buffer size of UART RX buffer.
    endmenu

endmenu
```
